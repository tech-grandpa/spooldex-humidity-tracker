## firmware/main/Kconfig
```kconfig
menu "Spooldex Humidity Tracker Configuration"

    config WIFI_SSID
        string "WiFi SSID"
        default ""
        help
            WiFi network name.

    config WIFI_PASSWORD
        string "WiFi Password"
        default ""
        help
            WiFi network password.

    config SPOOLDEX_URL
        string "Spooldex API URL"
        default "http://localhost:3000/api/humidity/readings"
        help
            REST endpoint for pushing sensor readings.

    config API_KEY
        string "API Key"
        default ""
        help
            Bearer token for API authentication.

    config BLE_SCAN_WINDOW_MS
        int "BLE Scan Window (ms)"
        default 5000
        help
            How long to actively scan for BLE advertisements per cycle.

    config BLE_SCAN_INTERVAL_MS
        int "BLE Scan Interval (ms)"
        default 10000
        help
            Time between BLE scan cycles.

    config PUSH_INTERVAL_S
        int "Push Interval (seconds)"
        default 300
        help
            How often to push sensor readings to REST API.

    config DISPLAY_ENABLED
        bool "Enable SSD1306 OLED Display"
        default y
        help
            Show sensor readings on an attached SSD1306 OLED.

    config DISPLAY_SDA_PIN
        int "Display SDA GPIO"
        depends on DISPLAY_ENABLED
        default 6

    config DISPLAY_SCL_PIN
        int "Display SCL GPIO"
        depends on DISPLAY_ENABLED
        default 7

    config MAX_SENSORS
        int "Maximum Tracked Sensors"
        default 16
        help
            Maximum number of sensors the hub can track simultaneously.

    config STATUS_LED_PIN
        int "Status LED GPIO"
        default 8
        help
            GPIO pin for status LED (ESP32-C6 default: GPIO8).

    config WATCHDOG_TIMEOUT_S
        int "Watchdog Timeout (seconds)"
        default 60
        help
            Task watchdog timeout. System will reboot if main loop hangs.

    config NTP_SERVER
        string "NTP Server"
        default "pool.ntp.org"
        help
            NTP server for time synchronization.

    config HEALTH_REPORT_INTERVAL_S
        int "Health Report Interval (seconds)"
        default 300
        help
            How often to push hub health metrics via REST API (uptime, free heap, etc.).

endmenu
```

## firmware/sdkconfig.defaults
```kconfig
# ESP32-C6 target
CONFIG_IDF_TARGET="esp32c6"

# BLE
CONFIG_BT_ENABLED=y
CONFIG_BT_NIMBLE_ENABLED=y
CONFIG_BT_NIMBLE_ROLE_CENTRAL=y
CONFIG_BT_NIMBLE_ROLE_OBSERVER=y
CONFIG_BT_NIMBLE_ROLE_PERIPHERAL=n
CONFIG_BT_NIMBLE_ROLE_BROADCASTER=n

# WiFi
CONFIG_ESP_WIFI_MODE_STA=y

# Power management
CONFIG_PM_ENABLE=y

# Logging
CONFIG_LOG_DEFAULT_LEVEL_INFO=y

# Task watchdog
CONFIG_ESP_TASK_WDT=y
CONFIG_ESP_TASK_WDT_TIMEOUT_S=60
CONFIG_ESP_TASK_WDT_PANIC=y

# SNTP
CONFIG_LWIP_SNTP_UPDATE_DELAY=3600000

# Partition table
CONFIG_PARTITION_TABLE_CUSTOM=y
CONFIG_PARTITION_TABLE_CUSTOM_FILENAME="partitions.csv"

# OTA
CONFIG_BOOTLOADER_APP_ROLLBACK_ENABLE=y

# Optimization for constrained device
CONFIG_COMPILER_OPTIMIZATION_SIZE=y
CONFIG_SPIRAM=n

# HTTP client
CONFIG_ESP_HTTP_CLIENT_ENABLE_HTTPS=y

# LCD panel (for SSD1306)
CONFIG_LCD_ENABLE_DEBUG_LOG=n
```
